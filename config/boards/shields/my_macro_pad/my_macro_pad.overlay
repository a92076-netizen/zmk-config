/ {
    chosen {
        zmk,kscan = &kscan0;
        zmk,matrix_transform = &default_transform;
    };

    kscan0: kscan {
        compatible = "zmk,kscan-gpio-matrix";

        diode-direction = "col2row";

        row-gpios = <&xiao_d 0 GPIO_ACTIVE_HIGH>;

        col-gpios = <&xiao_d 1 GPIO_ACTIVE_HIGH>,
                     <&xiao_d 2 GPIO_ACTIVE_HIGH>;
    };

    default_transform: matrix_transform {
        compatible = "zmk,matrix-transform";

        rows = <1>;
        columns = <2>;

        map = <
            RC(0,0)
            RC(0,1)
        >;
    };
};
